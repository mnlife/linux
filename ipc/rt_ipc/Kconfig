## ipc/rt_ipc/Kconfig
```kconfig
# SPDX-License-Identifier: GPL-2.0

config RT_IPC
	bool "Real-time migrating-thread IPC (rt_ipc)"
	depends on X86_64
	depends on RUST
	help
	  rt_ipc is a real-time inter-process communication mechanism based on
	  the migrating-thread model (Ford & Lepreau, USENIX 1994).  Instead of
	  dispatching a remote procedure call to a separate server thread — as
	  the static two-thread model, Android Binder and local sockets do — the
	  client's own thread migrates into the server address space and runs the
	  handler with the client's scheduling attributes.  Only the address
	  space and a small subset of CPU state are switched; the scheduler is
	  not involved.

	  Because the server code executes with the client's priority, the
	  classic priority-inversion problem cannot arise and no proxy-execution
	  machinery is required.  This yields significantly lower and more
	  predictable RPC latency than thread-handoff IPC.

	  The mechanism is implemented in Rust (endpoint registry and policy in a
	  small, unit-tested core) with a thin, arch-specific C/asm layer for the
	  partial context switch.  It adds three syscalls: rt_ipc_register,
	  rt_ipc_invoke and rt_ipc_return.

	  Userspace reference library, demo and tests live under
	  tools/testing/selftests/rt_ipc/.

	  If unsure, say N.
```

## ipc/rt_ipc_rust/Kconfig
```kconfig
# SPDX-License-Identifier: GPL-2.0
#
# rt_ipc_rust: Rust reimplementation of the migrating-thread real-time IPC.
#

config RT_IPC_RUST
	tristate "Real-time IPC (migrating-thread model), Rust reimplementation"
	depends on RUST
	depends on MMU
	help
	  rt_ipc_rust is a Rust counterpart to the C RT_IPC subsystem.  It
	  reproduces the same object model -- reference-counted endpoints
	  registered by servers, client connections bound to an endpoint and a
	  synchronous migrating-thread call path -- using the kernel's Rust
	  abstractions, and exposes it through the /dev/rt_ipc_rust control
	  device.

	  Objects are identified by integer handles managed in a global table
	  rather than by anonymous-inode file descriptors, because the Rust VFS
	  layer does not yet provide anon-inode / SCM_RIGHTS fd passing.  As in
	  the C foundation, the low-level partial context switch into the server
	  is not yet wired up, so RT_IPC_RUST_CALL performs the full setup and
	  then returns -EOPNOTSUPP.

	  To compile this as a module, choose M here: the module will be called
	  rt_ipc_rust.

	  If unsure, say N.
```
